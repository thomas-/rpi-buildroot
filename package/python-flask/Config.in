## package/python-flask/Config.in
```kconfig
config BR2_PACKAGE_PYTHON_FLASK
	bool "python-flask"
	help
	  Flask microwebframework.
```

## package/python-jinja2/Config.in
```kconfig
config BR2_PACKAGE_PYTHON_JINJA2
	bool "python-jinja2"
	help
	  Jinja2 templating engine.
```

## package/python-werkzeug/Config.in
```kconfig
config BR2_PACKAGE_PYTHON_WORKZEUG
	bool "python-werkzeug"
	help
	  Flask dependency.
```
